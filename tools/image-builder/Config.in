## tools/image-builder/buildroot-config/homehub_x86_64_defconfig
```kconfig
BR2_x86_64=y
BR2_x86_corei7=y
BR2_TOOLCHAIN_BUILDROOT_GLIBC=y
BR2_INIT_SYSTEMD=y
BR2_ROOTFS_DEVICE_CREATION_DYNAMIC_EUDEV=y
BR2_TARGET_GENERIC_HOSTNAME="homehub"
BR2_TARGET_GENERIC_ISSUE="Home Hub OS"
BR2_LINUX_KERNEL=y
BR2_LINUX_KERNEL_CUSTOM_VERSION=y
BR2_LINUX_KERNEL_CUSTOM_VERSION_VALUE="6.6.77"
BR2_LINUX_KERNEL_USE_ARCH_DEFAULT_CONFIG=y
BR2_LINUX_KERNEL_CONFIG_FRAGMENT_FILES="$(BR2_EXTERNAL_HOMEHUB_PATH)/buildroot-config/linux.fragment"
BR2_LINUX_KERNEL_BZIMAGE=y
BR2_PACKAGE_HOST_GENIMAGE=y
BR2_TARGET_GRUB2=y
BR2_TARGET_GRUB2_X86_64_EFI=y
BR2_PACKAGE_HOMEHUB=y
BR2_PACKAGE_DBUS=y
BR2_PACKAGE_LIBINPUT=y
BR2_PACKAGE_LIBXKBCOMMON=y
BR2_PACKAGE_WAYLAND=y
BR2_PACKAGE_MESA3D=y
BR2_PACKAGE_MESA3D_OPENGL_EGL=y
BR2_PACKAGE_MESA3D_OPENGL_ES=y
BR2_PACKAGE_MESA3D_GALLIUM_DRIVER_SWRAST=y
BR2_PACKAGE_MESA3D_GALLIUM_DRIVER_IRIS=y
BR2_PACKAGE_MESA3D_GALLIUM_DRIVER_RADEONSI=y
BR2_PACKAGE_PIPEWIRE=y
BR2_PACKAGE_WIREPLUMBER=y
BR2_PACKAGE_NETWORK_MANAGER=y
BR2_PACKAGE_LABWC=y
BR2_PACKAGE_WEBKITGTK=y
BR2_PACKAGE_GTK3=y
BR2_PACKAGE_SQUASHFS=y
BR2_TARGET_ROOTFS_SQUASHFS=y
```

## tools/image-builder/package/homehub/Config.in
```kconfig
config BR2_PACKAGE_HOMEHUB
	bool "Home Hub service suite"
	depends on BR2_USE_MMU
	depends on BR2_TOOLCHAIN_USES_GLIBC
	depends on BR2_PACKAGE_HOST_RUSTC_TARGET_ARCH_SUPPORTS
	select BR2_PACKAGE_HOST_RUSTC
	select BR2_PACKAGE_OPENSSL
	select BR2_PACKAGE_SQLITE
	help
	  Builds hh-service, hh-session and hh-tools from the local locked
	  Rust workspace. Runtime units and user policy are separate board
	  integration work.
```
